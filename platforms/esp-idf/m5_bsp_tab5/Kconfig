## platforms/esp-idf/m5_bsp_tab5/Kconfig
```kconfig
menu "M5Stack Tab5 board"

    config M5_TAB5_I2C_PORT
        int "System I2C port"
        range 0 1
        default 0

    config M5_TAB5_BACKLIGHT_LEDC_TIMER
        int "LEDC timer for the LCD backlight"
        range 0 3
        default 1

    config M5_TAB5_BACKLIGHT_LEDC_CHANNEL
        int "LEDC channel for the LCD backlight"
        range 0 7
        default 1

    config M5_TAB5_CHARGE_ENABLE
        bool "Enable battery charging in m5_tab5_init"
        default y
        help
            Drives expander 1 P7 high. Without it the battery does not charge
            from USB-C.

    config M5_TAB5_QUICK_CHARGE_ENABLE
        bool "Enable quick charge in m5_tab5_init"
        default y
        depends on M5_TAB5_CHARGE_ENABLE
        help
            Drives expander 1 P5 (active low) low.

endmenu
```

## platforms/esp-idf/pocket_app_host/Kconfig
```kconfig
menu "PocketJS application host"
    config POCKET_APP_HOST_WORKER
        bool "Enable independent worker realms"
        default n
        help
            Requires -DPOCKETJS_ENABLE_WORKER=ON in the Tab5 program.
            Firmware supplies permitted IO nodes in the host worker
            configuration. Each app worker stops before its package storage
            and UI realm are released.
endmenu
```

## programs/m5stack-tab5/components/pocket_system/Kconfig
```kconfig
menu "Pocket system services"

    config POCKET_SYSTEM_SNTP_SERVER
        string "SNTP server"
        default "pool.ntp.org"
        help
            The NTP server the wall clock synchronizes with each time the
            radio is assigned an address.

endmenu
```

## programs/tab5-worker/sdkconfig.defaults
```kconfig
CONFIG_IDF_TARGET="esp32p4"
CONFIG_ESP32P4_SELECTS_REV_LESS_V3=y
CONFIG_ESP32P4_REV_MIN_100=y
CONFIG_ESPTOOLPY_FLASHMODE_QIO=y
CONFIG_ESPTOOLPY_FLASHSIZE_16MB=y
CONFIG_COMPILER_OPTIMIZATION_PERF=y
CONFIG_FREERTOS_HZ=1000
CONFIG_ESP_MAIN_TASK_STACK_SIZE=16384
CONFIG_ESP_CONSOLE_USB_SERIAL_JTAG=y
CONFIG_PARTITION_TABLE_CUSTOM=y
CONFIG_PARTITION_TABLE_CUSTOM_FILENAME="partitions.csv"
```

## programs/tab5/main/Kconfig.projbuild
```kconfig
menu "PocketJS Tab5 firmware"

    config TAB5_UI_VALIDATION
        bool "Enable USB JTAG UI capture and synthetic taps"
        default n
        help
            Program-layer validation hooks expose a bounded debugger mailbox,
            preserve a 720x1280 RGB565 frame in 1.76 MiB PSRAM, and inject
            contacts through the normal runtime input path. Use the
            tools/tab5-ui-validation.py tool with USB JTAG. Disable for the
            firmware left on a user's device after validation.

    config TAB5_RENDERER_PPA
        bool "Render through the ESP32-P4 PPA"
        default y
        help
            Registers the PPA renderer for fills, glyph blends and texture
            scaling. Unsupported operations fall back to software. Disable to
            use the software renderer only.

    config TAB5_BACKLIGHT_PERCENT
        int "Backlight level at boot (percent)"
        range 1 100
        default 80

    config TAB5_RUNTIME_HEAP_KB
        int "Runtime heap limit per app (KiB)"
        range 1024 24576
        default 12288

    config TAB5_GUEST_HEAP_KB
        int "QuickJS heap limit per app (KiB)"
        range 1024 16384
        default 8192

endmenu
```
